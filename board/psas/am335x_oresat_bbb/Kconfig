## board/psas/am335x_oresat_bbb/Kconfig
```kconfig
if TARGET_AM335X_ORESAT_BBB

config SYS_BOARD
	default "oresat_bbb"

config SYS_VENDOR
	default "psas"

config SYS_SOC
	default "am33xx"

config SYS_CONFIG_NAME
	default "am335x_oresat_bbb"

config NOR
	bool "Support for NOR flash"
	help
	  The AM335x SoC supports having a NOR flash connected to the GPMC.
	  In practice this is seen as a NOR flash module connected to the
	  "memory cape" for the BeagleBone family.

source "board/ti/common/Kconfig"

endif
```

## board/psas/oresat/Kconfig
```kconfig
if TARGET_AM335X_ORESAT

config SYS_BOARD
	default "oresat"

config SYS_VENDOR
	default "psas"

config SYS_SOC
	default "am33xx"

config SYS_CONFIG_NAME
	default "am335x_oresat"

config NOR
	bool "Support for NOR flash"
	help
	  The AM335x SoC supports having a NOR flash connected to the GPMC.
	  In practice this is seen as a NOR flash module connected to the
	  "memory cape" for the BeagleBone family.

source "board/psas/common/Kconfig"

endif
```
